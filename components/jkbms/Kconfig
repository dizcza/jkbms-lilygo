## components/jkbms/Kconfig
```kconfig
menu "JK BMS BLE"

    config JKBMS_NUM_DEVICES
        int "Number of JK BMS devices to monitor"
        range 1 3
        default 2

    config JKBMS_MAC_1
        string "BMS 1 MAC address"
        default ""
        help
            MAC address of the first BMS, e.g. "C8:47:8C:12:34:56".
            Leave empty to pick it on the screen; the pick is saved to NVS.
            Hold the left button for 1.5 s to forget it and pick again.

    config JKBMS_MAC_2
        string "BMS 2 MAC address"
        default ""
        depends on JKBMS_NUM_DEVICES >= 2
        help
            MAC address of the second BMS. Leave empty to pick it on the screen.

    config JKBMS_MAC_3
        string "BMS 3 MAC address"
        default ""
        depends on JKBMS_NUM_DEVICES >= 3
        help
            MAC address of the third BMS. Leave empty to pick it on the screen.

    config JKBMS_NAME_PREFIX
        string "Advertised name prefix of JK BMS"
        default "JK"
        help
            A device whose advertised name starts with this prefix, or which
            advertises the 0xFFE0 service or JK manufacturer data (0x0B65),
            is treated as a JK BMS candidate.

endmenu
```

## main/Kconfig.projbuild
```kconfig
menu "JK BMS monitor UI"

    config UI_SCREENSHOT_CONSOLE
        bool "Serial console to drive the UI and take screenshots (development)"
        default n
        select LV_USE_SNAPSHOT
        help
            Single-character commands on the console UART: n/p = right/left
            button, L = long left press, a = made-up BMS names and MACs,
            s = dump the screen as hex RGB565.
            Used by tools/screenshots.py.

    config UI_AUTO_SELECT_S
        int "Auto-select the only BMS found after N seconds"
        range 1 60
        default 5

endmenu

menu "JK BMS status upload"

    config UPLOAD_PERIOD_S
        int "Read the BMS and upload the status every N seconds (0 = never)"
        range 0 86400
        default 60
        help
            The BMS is reconnected about once per period for fresh data (it
            beeps on every connection) and the status is POSTed over Wi-Fi
            as soon as the new data streams in. The
            endpoint URL, the API token and the Wi-Fi networks are build-time
            secrets, see main/CMakeLists.txt.

    config UPLOAD_COLLECT_FIRST
        bool "Read everything from the BMS first, send it later"
        default n
        help
            For a BMS out of Wi-Fi reach: the status, the settings and the
            whole logbook are read first ("Зчитано" shows for 5 s), and only
            then sent, so that the board can be carried from the BMS to the
            Wi-Fi router on a power bank. Built into the second OTA slot by
            tools/make_dual_image.sh; the right button held for 5 s switches
            between the two.

    config UPLOAD_EXTRAS_EVERY
        int "Re-read the BMS logbook for new events every N uploads"
        range 1 1000
        default 10


endmenu
```
